## Kconfig
```kconfig
menuconfig KCONFIG_DCA
    bool "Configure Doriot Data Collection Agent"
    default y
    help
        This will enable configuring Data Collection Agent

if KCONFIG_DCA

config DCA_SHELL
    bool "Enable DCA shell commands"
    default y

config DCA_PS
    bool "Enable /runtime/ps statistics"
    default y

config DCA_NETWORK
    bool "Enable /network statistics"
    default y

config DCA_SAUL
    bool "Enable /saul statistics"
    default y

config DCA_UDP_SERVER_PORT
    int "UDP server port for throughput measurements"
    default 1338

endif # KCONFIG_DCA
```

## examples/coap/Kconfig
```kconfig
menuconfig KCONFIG_APP
    bool "Configure application"
    default y
    help
        This will enable configuring the application

if KCONFIG_APP

config DCA_NETWORK
    bool "Enable UDP throughput server"
    default y

endif # KCONFIG_DCA
```

## examples/vfs/Kconfig
```kconfig
menu "DCA Test Application"

config USE_DCAFS
    bool "Use dcafs"
    default y
    help 
        Enable vfs interface and mount dcafs

endmenu # Application
```
